## rootfs/configs/buildroot_defconfig
```kconfig
BR2_arm=y
BR2_cortex_a9=y
BR2_ARM_ENABLE_NEON=y
BR2_ARM_FPU_NEON=y
BR2_DEPRECATED=y
BR2_PACKAGE_OVERRIDE_FILE="$(BR2_EXTERNAL)/local.mk"
BR2_GLOBAL_PATCH_DIR="$(BR2_EXTERNAL)/patches"
BR2_KERNEL_HEADERS_3_10=y
BR2_TOOLCHAIN_BUILDROOT_GLIBC=y
BR2_TOOLCHAIN_BUILDROOT_CXX=y
BR2_GENERATE_LOCALE="en_US"
BR2_TARGET_OPTIMIZATION="-pipe"
BR2_TARGET_GENERIC_HOSTNAME="outerbox"
BR2_TARGET_GENERIC_ISSUE="Welcome to Outerbox"
BR2_INIT_NONE=y
BR2_ROOTFS_DEVICE_CREATION_DYNAMIC_EUDEV=y
BR2_ROOTFS_DEVICE_TABLE="$(BR2_EXTERNAL)/configs/device_table.txt"
BR2_SYSTEM_DHCP="eth0"
BR2_TARGET_TZ_INFO=y
BR2_ROOTFS_USERS_TABLES="$(BR2_EXTERNAL)/configs/users"
BR2_ROOTFS_OVERLAY="$(BR2_EXTERNAL)/rootfs_overlay"
BR2_ROOTFS_POST_BUILD_SCRIPT="$(BR2_EXTERNAL)/scripts/collect_static.sh $(BR2_EXTERNAL)/scripts/platform.sh $(BR2_EXTERNAL)/scripts/reset_token.sh"
BR2_ROOTFS_POST_IMAGE_SCRIPT="$(BR2_EXTERNAL)/scripts/mkpkg.sh"
BR2_LINUX_KERNEL=y
BR2_LINUX_KERNEL_CUSTOM_GIT=y
BR2_LINUX_KERNEL_CUSTOM_REPO_URL="https://github.com/Outernet-Project/outernetrx-linux.git"
BR2_LINUX_KERNEL_CUSTOM_REPO_VERSION="5e133510514372e14790f43d4eda313acef6cbc0"
BR2_LINUX_KERNEL_USE_CUSTOM_CONFIG=y
BR2_LINUX_KERNEL_CUSTOM_CONFIG_FILE="$(BR2_EXTERNAL)/configs/kernel_defconfig"
BR2_LINUX_KERNEL_DTS_SUPPORT=y
BR2_LINUX_KERNEL_INTREE_DTS_NAME="wetek_play"
BR2_LINUX_KERNEL_USE_DTD=y
BR2_PACKAGE_BUSYBOX_CONFIG="$(BR2_EXTERNAL)/configs/busybox.config"
BR2_PACKAGE_BUSYBOX_SHOW_OTHERS=y
BR2_PACKAGE_BUSYBOX_WATCHDOG=y
BR2_PACKAGE_GDB=y
BR2_PACKAGE_GDB_DEBUGGER=y
BR2_PACKAGE_DOSFSTOOLS=y
BR2_PACKAGE_DOSFSTOOLS_FSCK_FAT=y
BR2_PACKAGE_E2FSPROGS=y
# BR2_PACKAGE_E2FSPROGS_BADBLOCKS is not set
# BR2_PACKAGE_E2FSPROGS_CHATTR is not set
# BR2_PACKAGE_E2FSPROGS_DUMPE2FS is not set
# BR2_PACKAGE_E2FSPROGS_E2FREEFRAG is not set
# BR2_PACKAGE_E2FSPROGS_E2LABEL is not set
# BR2_PACKAGE_E2FSPROGS_E2UNDO is not set
# BR2_PACKAGE_E2FSPROGS_FILEFRAG is not set
# BR2_PACKAGE_E2FSPROGS_FINDFS is not set
# BR2_PACKAGE_E2FSPROGS_LOGSAVE is not set
# BR2_PACKAGE_E2FSPROGS_LSATTR is not set
# BR2_PACKAGE_E2FSPROGS_TUNE2FS is not set
# BR2_PACKAGE_E2FSPROGS_UUIDGEN is not set
BR2_PACKAGE_MTD=y
# BR2_PACKAGE_MTD_FLASHCP is not set
# BR2_PACKAGE_MTD_FLASH_LOCK is not set
# BR2_PACKAGE_MTD_FLASH_UNLOCK is not set
# BR2_PACKAGE_MTD_MTD_DEBUG is not set
# BR2_PACKAGE_MTD_NANDDUMP is not set
# BR2_PACKAGE_MTD_NANDTEST is not set
# BR2_PACKAGE_MTD_NANDWRITE is not set
# BR2_PACKAGE_MTD_MTDINFO is not set
# BR2_PACKAGE_MTD_UBICRC32 is not set
# BR2_PACKAGE_MTD_UBIFORMAT is not set
# BR2_PACKAGE_MTD_UBINIZE is not set
# BR2_PACKAGE_MTD_UBIRENAME is not set
# BR2_PACKAGE_MTD_UBIRSVOL is not set
# BR2_PACKAGE_MTD_UBIUPDATEVOL is not set
# BR2_PACKAGE_MTD_UBIBLOCK is not set
BR2_PACKAGE_NTFS_3G=y
BR2_PACKAGE_FBSET=y
BR2_PACKAGE_LINUX_FIRMWARE=y
BR2_PACKAGE_LINUX_FIRMWARE_RALINK_RT2XX=y
# BR2_PACKAGE_EUDEV_ENABLE_HWDB is not set
BR2_PACKAGE_PYTHON=y
BR2_PACKAGE_PYTHON_PY_ONLY=y
BR2_PACKAGE_PYTHON_SSL=y
BR2_PACKAGE_PYTHON_SQLITE=y
BR2_PACKAGE_PYTHON_PYEXPAT=y
BR2_PACKAGE_PYTHON_HASHLIB=y
BR2_PACKAGE_PYTHON_MARKUPSAFE=y
BR2_PACKAGE_SQLITE_READLINE=y
BR2_PACKAGE_LIBCURL=y
BR2_PACKAGE_CURL=y
BR2_PACKAGE_BRIDGE_UTILS=y
BR2_PACKAGE_DNSMASQ=y
# BR2_PACKAGE_DNSMASQ_TFTP is not set
BR2_PACKAGE_DROPBEAR=y
BR2_PACKAGE_DROPBEAR_DISABLE_REVERSEDNS=y
BR2_PACKAGE_HOSTAPD=y
BR2_PACKAGE_IPTABLES=y
BR2_PACKAGE_IW=y
BR2_PACKAGE_LIGHTTPD=y
BR2_PACKAGE_LIGHTTPD_PCRE=y
BR2_PACKAGE_NTP=y
BR2_PACKAGE_NTP_NTPDATE=y
BR2_PACKAGE_NTP_NTPQ=y
BR2_PACKAGE_SUDO=y
BR2_PACKAGE_XMLSTARLET=y
BR2_PACKAGE_NANO=y
# BR2_TARGET_ROOTFS_TAR is not set
BR2_TARGET_ROOTFS_UBIFS=y
BR2_TARGET_ROOTFS_UBIFS_LEBSIZE=0x1fc000
BR2_TARGET_ROOTFS_UBIFS_MINIOSIZE=0x2000
BR2_TARGET_ROOTFS_UBIFS_MAXLEBCNT=2017
BR2_OUTERBOX_SIGNATURE_FILE="$(BR2_EXTERNAL)/pkg/package.pem"
BR2_OUTERBOX_TMPFS_SIZE="100"
BR2_OUTERBOX_VERSIONLESS_PKG=y
BR2_PACKAGE_PYTHON_LIBRARIAN=y
BR2_PACKAGE_PYTHON_LIBRARIAN_UI=y
BR2_PACKAGE_PYTHON_LIBRARIAN_LOGS=y
BR2_PACKAGE_PYTHON_LIBRARIAN_ONDD=y
BR2_PACKAGE_PYTHON_LIBRARIAN_DISKSPACE=y
BR2_PACKAGE_PYTHON_LIBRARIAN_NETINTERFACES=y
BR2_PACKAGE_PYTHON_LIBRARIAN_LIBRARY=y
BR2_PACKAGE_PYTHON_LIBRARIAN_TWITTER=y
BR2_PACKAGE_PYTHON_LIBRARIAN_OPENER_HTML=y
BR2_PACKAGE_PYTHON_LIBRARIAN_OPENER_VIDEO=y
BR2_PACKAGE_PYTHON_LIBRARIAN_CAPTIVE=y
BR2_PACKAGE_MONITORING=y
BR2_PACKAGE_PYTHON_PSYCOPG2=y
BR2_PACKAGE_PKGTOOL=y
BR2_PACKAGE_HOST_PKGTOOL=y
```

## rootfs/package/libvdpau-sunxi/Config.in
```kconfig
config BR2_PACKAGE_LIBVDPAU_SUNXI
	bool "libvdpau-sunxi"
	select BR2_PACKAGE_LIBVDPAU
	help
	  This is an experimental VDPAU implementation for sunxi SoCs.

	  It supports decoding of MPEG1 and MPEG2, some limited MPEG4 types,
	  H.264 and on the H3 SoC it also decodes H.265.

	  https://github.com/linux-sunxi/libvdpau-sunxi
```

## rootfs/package/python-librarian-content/Config.in
```kconfig
config BR2_PACKAGE_PYTHON_LIBRARIAN_CONTENT
	bool "python-librarian-content"
	depends on BR2_PACKAGE_PYTHON || BR2_PACKAGE_PYTHON3
	select BR2_PACKAGE_PYTHON_LIBRARIAN_CORE
	select BR2_PACKAGE_PYTHON_FSAL
	select BR2_PACKAGE_PYTHON_HACHOIR_METADATA
	select BR2_PACKAGE_PYTHON_HACHOIR_PARSER
	help
      Librarian content management base API

	  https://github.com/Outernet-Project/librarian-content/
```

## rootfs/package/vdr/Config.in
```kconfig
config BR2_PACKAGE_VDR
	bool "vdr"
	depends on BR2_PACKAGE_XORG7
	select BR2_PACKAGE_XLIB_LIBX11
	select BR2_PACKAGE_XLIB_LIBXEXT
	select BR2_PACKAGE_XLIB_LIBXRENDER
	select BR2_PACKAGE_LIBCAP
	select BR2_PACKAGE_JPEG
	select BR2_PACKAGE_FONTCONFIG
	select BR2_PACKAGE_FREETYPE
	help
	  The Video Disk Recorder

	  http://www.tvdr.de

comment "vdr depends on Xorg"
	depends on !BR2_PACKAGE_XORG7

if BR2_PACKAGE_VDR

menu "VDR plugins selection"

config BR2_PACKAGE_VDR_XINELIBOUTPUT
	bool "vdr-xineliboutput"
	depends on BR2_PACKAGE_XINELIB
	default n
	help
	  xineliboutput plugin

comment "vdr-xineliboutput depends on xinelib"
	depends on !BR2_PACKAGE_XINELIB

endmenu

endif
```

## rootfs/package/wptdm/Config.in
```kconfig
config BR2_PACKAGE_WPTDM
	bool "wptdm"
	select BR2_PACKAGE_OPENSSL
	help
	  Remote management client
	  
	  http://outernet.is/
```

## rootfs/package/xdriver_xf86-video-fbturbo-ump/Config.in
```kconfig
config BR2_PACKAGE_XDRIVER_XF86_VIDEO_FBTURBO_UMP
	bool "xf86-video-fbturbo-ump"
	select BR2_PACKAGE_LIBDRM
	select BR2_PACKAGE_LIBUMP2
	select BR2_PACKAGE_PIXMAN
	select BR2_PACKAGE_XPROTO_FONTSPROTO
	select BR2_PACKAGE_XPROTO_RANDRPROTO
	select BR2_PACKAGE_XPROTO_RENDERPROTO
	select BR2_PACKAGE_XPROTO_VIDEOPROTO
	select BR2_PACKAGE_XPROTO_XPROTO
	select BR2_PACKAGE_XPROTO_XF86DRIPROTO
	help
	  video driver, primarily optimized for the devices powered
	  by the Allwinner SoC (A10, A13, A20). It can use some of
	  the 2D/3D hardware acceleration features.

	  https://github.com/ssvb/xf86-video-fbturbo
```

## rootfs/package/xinelib/Config.in
```kconfig
config BR2_PACKAGE_XINELIB
	bool "xinelib"
	select BR2_PACKAGE_FFMPEG
	select BR2_PACKAGE_XLIB_LIBXV
	select BR2_PACKAGE_ALSA_LIB
	select BR2_PACKAGE_XLIB_LIBICE
	select BR2_PACKAGE_XLIB_LIBSM
	select BR2_PACKAGE_XLIB_LIBXEXT
	select BR2_PACKAGE_MESA3D
	select BR2_PACKAGE_LIBVDPAU
	select BR2_PACKAGE_LIBBLURAY
	select BR2_PACKAGE_FLAC
	select BR2_PACKAGE_LIBGLU
	select BR2_PACKAGE_LIBMAD
	select BR2_PACKAGE_LIBMODPLUG
	select BR2_PACKAGE_LIBVORBIS
	default n
	help
	  xine is a free multimedia player. It plays back CDs, DVDs, and VCDs. It
	  also decodes multimedia files like AVI, MOV, WMV, and MP3 from local disk
	  drives, and displays multimedia streamed over the Internet. It interprets
	  many of the most common multimedia formats available – and some of the
	  most uncommon formats, too.

	  https://www.xine-project.org/

comment "xinelib depends on libgl, libglu"
	depends on !BR2_PACKAGE_HAS_LIBGL || !BR2_PACKAGE_LIBGLU
```
