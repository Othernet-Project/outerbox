## common/configs/kernel_defconfig
```kconfig
# CONFIG_LOCALVERSION_AUTO is not set
CONFIG_DEFAULT_HOSTNAME="outerbox"
# CONFIG_SWAP is not set
CONFIG_SYSVIPC=y
CONFIG_NO_HZ=y
CONFIG_HIGH_RES_TIMERS=y
CONFIG_BSD_PROCESS_ACCT=y
CONFIG_IKCONFIG=y
CONFIG_IKCONFIG_PROC=y
CONFIG_BLK_DEV_INITRD=y
CONFIG_INITRAMFS_SOURCE=" "
CONFIG_SYSCTL_SYSCALL=y
# CONFIG_AIO is not set
CONFIG_EMBEDDED=y
# CONFIG_VM_EVENT_COUNTERS is not set
CONFIG_MODULES=y
CONFIG_MODULE_UNLOAD=y
# CONFIG_BLK_DEV_BSG is not set
CONFIG_BLK_DEV_INTEGRITY=y
CONFIG_PARTITION_ADVANCED=y
CONFIG_MAC_PARTITION=y
CONFIG_LDM_PARTITION=y
# CONFIG_IOSCHED_CFQ is not set
CONFIG_ARCH_MESON6=y
CONFIG_MESON_CLOCK_TICK_RATE=25000000
CONFIG_MESON_SUSPEND=y
CONFIG_MESON_LEGACY_REGISTER_API=y
CONFIG_MESON_CPU_TEMP_SENSOR=y
CONFIG_MESON6_SMP_HOTPLUG=y
CONFIG_MESON_L2CC_OPTIMIZE=y
CONFIG_MESON_CUSTOM_BOARD_SUPPORT=y
CONFIG_ARM_ERRATA_751472=y
CONFIG_ARM_ERRATA_754322=y
CONFIG_ARM_ERRATA_764369=y
CONFIG_SMP=y
CONFIG_NR_CPUS=2
CONFIG_PREEMPT=y
CONFIG_AEABI=y
CONFIG_HIGHMEM=y
# CONFIG_COMPACTION is not set
CONFIG_DEPRECATED_PARAM_STRUCT=y
CONFIG_BUILD_ARM_APPENDED_DTB_IMAGE=y
CONFIG_BUILD_ARM_APPENDED_DTB_IMAGE_NAMES="meson6_g18"
CONFIG_ZBOOT_ROM_TEXT=0x0
CONFIG_ZBOOT_ROM_BSS=0x0
CONFIG_ARM_APPENDED_DTB=y
CONFIG_ARM_ATAG_DTB_COMPAT=y
CONFIG_ARM_ATAG_DTB_COMPAT_CMDLINE_APPEND=y
CONFIG_CMDLINE="console=tty0"
CONFIG_CMDLINE_APPEND=y
CONFIG_CPU_FREQ=y
CONFIG_CPU_FREQ_DEFAULT_GOV_ONDEMAND=y
# CONFIG_CPU_FREQ_GOV_HOTPLUG is not set
CONFIG_CPU_FREQ_GOV_CONSERVATIVE=y
CONFIG_AMLOGIC_MESON_CPUFREQ=y
CONFIG_VFP=y
CONFIG_NEON=y
CONFIG_BINFMT_MISC=y
CONFIG_WAKELOCK=y
CONFIG_NO_USER_SPACE_SCREEN_ACCESS_CONTROL=y
CONFIG_PM_RUNTIME=y
CONFIG_PACKET=y
CONFIG_UNIX=y
CONFIG_NET_KEY=y
CONFIG_INET=y
CONFIG_IP_MULTICAST=y
CONFIG_IP_ADVANCED_ROUTER=y
CONFIG_IP_MULTIPLE_TABLES=y
CONFIG_IP_PNP=y
CONFIG_IP_PNP_DHCP=y
# CONFIG_INET_XFRM_MODE_TRANSPORT is not set
# CONFIG_INET_XFRM_MODE_TUNNEL is not set
# CONFIG_INET_XFRM_MODE_BEET is not set
# CONFIG_INET_LRO is not set
# CONFIG_INET_DIAG is not set
# CONFIG_IPV6 is not set
# CONFIG_ANDROID_PARANOID_NETWORK is not set
# CONFIG_NET_ACTIVITY_STATS is not set
CONFIG_NETFILTER=y
# CONFIG_BRIDGE_NETFILTER is not set
CONFIG_NF_CONNTRACK=y
# CONFIG_NF_CONNTRACK_PROCFS is not set
CONFIG_NF_CONNTRACK_IPV4=y
CONFIG_IP_NF_IPTABLES=y
CONFIG_IP_NF_FILTER=y
CONFIG_NF_NAT_IPV4=y
CONFIG_IP_NF_TARGET_REDIRECT=y
CONFIG_BRIDGE=y
# CONFIG_RPS is not set
CONFIG_CFG80211=y
CONFIG_MAC80211=y
CONFIG_MAC80211_LEDS=y
CONFIG_EARLY_INIT=y
CONFIG_I2C_AML=y
CONFIG_SARADC_AM=y
CONFIG_MESON_CS_DCDC_REGULATOR=y
CONFIG_SECURITYKEY=y
CONFIG_EFUSE=y
CONFIG_AMLOGIC_USB=y
CONFIG_MMC_AML=y
CONFIG_AMLOGIC_SPI_NOR=y
CONFIG_AML_NFTL_NEW=y
CONFIG_AML_NAND_KEY=y
# CONFIG_AML_NEXT_NAND is not set
CONFIG_AM_ETHERNET=y
CONFIG_AML_LAN8720=y
CONFIG_AML_IP101_PHY=y
CONFIG_AML_KSZ8091=y
CONFIG_AM_WIFI=y
CONFIG_AM_WIFI_SD_MMC=y
CONFIG_SDIO_DHD_CDC_WIFI_40181_MODULE=y
CONFIG_BCMDHD_FW_PATH="/lib/firmware/brcm/"
CONFIG_BCMDHD_NVRAM_PATH="/lib/firmware/brcm/ap6210-nvram.txt"
CONFIG_BCMDHD_CONFIG_PATH="/lib/firmware/brcm/config.txt"
CONFIG_BCMDHD_POWER_OFF_IN_SUSPEND=y
CONFIG_VSYNC_RDMA=y
CONFIG_AM_VIDEO=y
CONFIG_AM_VDEC_H264MVC=y
# CONFIG_AM_LCD_OUTPUT is not set
CONFIG_FB_AM=y
# CONFIG_FB_OSD_SUPPORT_SYNC_FENCE is not set
CONFIG_FB_OSD2_DEFAULT_WIDTH=1280
CONFIG_FB_OSD2_DEFAULT_HEIGHT=720
CONFIG_FB_OSD2_DEFAULT_WIDTH_VIRTUAL=1280
CONFIG_FB_OSD2_DEFAULT_HEIGHT_VIRTUAL=1440
CONFIG_FB_OSD1_DEFAULT_BITS_PER_PIXEL=32
CONFIG_FB_OSD1_DEFAULT_WIDTH=1280
CONFIG_FB_OSD1_DEFAULT_HEIGHT=720
CONFIG_FB_OSD1_DEFAULT_WIDTH_VIRTUAL=1280
CONFIG_FB_OSD1_DEFAULT_HEIGHT_VIRTUAL=1440
# CONFIG_AMLOGIC_BACKLIGHT is not set
CONFIG_AM_GE2D=y
CONFIG_AM_LOGO=y
CONFIG_AM_HDMI_ONLY=y
# CONFIG_AML_EXT_HDMIIN is not set
CONFIG_POST_PROCESS_MANAGER=y
CONFIG_POST_PROCESS_MANAGER_PPSCALER=y
CONFIG_POST_PROCESS_MANAGER_3D_PROCESS=y
# CONFIG_VIDEOBUF2_ION is not set
CONFIG_DEINTERLACE=y
CONFIG_WETEK=y
CONFIG_UMP=y
CONFIG_MALI400_UMP=y
# CONFIG_AMLOGIC_ION is not set
# CONFIG_CRYPTO_DEVICE_DRIVER is not set
CONFIG_UEVENT_HELPER_PATH="/sbin/mdev"
CONFIG_DEVTMPFS=y
CONFIG_DEVTMPFS_MOUNT=y
CONFIG_MTD_UBI=y
CONFIG_BLK_DEV_LOOP=y
CONFIG_EEPROM_93CX6=m
CONFIG_SCSI=y
CONFIG_BLK_DEV_SD=y
CONFIG_SCSI_MULTI_LUN=y
# CONFIG_SCSI_LOWLEVEL is not set
CONFIG_NETDEVICES=y
CONFIG_TUN=y
# CONFIG_NET_CADENCE is not set
# CONFIG_NET_VENDOR_BROADCOM is not set
# CONFIG_NET_VENDOR_CIRRUS is not set
# CONFIG_NET_VENDOR_FARADAY is not set
# CONFIG_NET_VENDOR_INTEL is not set
# CONFIG_NET_VENDOR_MARVELL is not set
# CONFIG_NET_VENDOR_MICREL is not set
# CONFIG_NET_VENDOR_MICROCHIP is not set
# CONFIG_NET_VENDOR_NATSEMI is not set
# CONFIG_NET_VENDOR_SEEQ is not set
# CONFIG_NET_VENDOR_SMSC is not set
# CONFIG_NET_VENDOR_STMICRO is not set
# CONFIG_NET_VENDOR_WIZNET is not set
CONFIG_USB_USBNET=y
CONFIG_USB_NET_RNDIS_HOST=m
CONFIG_RT2X00=y
CONFIG_RT2800USB=y
# CONFIG_RT2800USB_RT33XX is not set
# CONFIG_RT2800USB_RT35XX is not set
CONFIG_RT2800USB_RT53XX=y
CONFIG_INPUT_FF_MEMLESS=y
# CONFIG_INPUT_MOUSEDEV is not set
CONFIG_INPUT_EVDEV=y
# CONFIG_KEYBOARD_ATKBD is not set
CONFIG_KEYBOARD_GPIO=y
# CONFIG_INPUT_MOUSE is not set
# CONFIG_SERIO is not set
CONFIG_VT_HW_CONSOLE_BINDING=y
# CONFIG_LEGACY_PTYS is not set
CONFIG_TTY_PRINTK=y
CONFIG_HVC_DCC=y
# CONFIG_HW_RANDOM is not set
CONFIG_SPI_GPIO=y
CONFIG_SPI_SPIDEV=y
CONFIG_GPIO_SYSFS=y
CONFIG_MEDIA_SUPPORT=y
CONFIG_MEDIA_CAMERA_SUPPORT=y
CONFIG_MEDIA_ANALOG_TV_SUPPORT=y
CONFIG_MEDIA_RADIO_SUPPORT=y
CONFIG_MEDIA_RC_SUPPORT=y
# CONFIG_DVB_DYNAMIC_MINORS is not set
CONFIG_LIRC=m
CONFIG_RC_DEVICES=y
CONFIG_RC_ATI_REMOTE=m
CONFIG_IR_IMON=m
CONFIG_IR_MCEUSB=m
CONFIG_IR_REDRAT3=m
CONFIG_IR_STREAMZAP=m
CONFIG_IR_IGUANA=m
CONFIG_IR_TTUSBIR=m
CONFIG_IR_GPIO_CIR=m
CONFIG_MEDIA_USB_SUPPORT=y
# CONFIG_USB_GSPCA is not set
CONFIG_ION=y
CONFIG_FIRMWARE_EDID=y
CONFIG_FB_FOREIGN_ENDIAN=y
CONFIG_FB_TILEBLITTING=y
CONFIG_FB_S1D13XXX=m
CONFIG_FB_SMSCUFX=m
CONFIG_FB_UDL=m
CONFIG_FB_GOLDFISH=m
CONFIG_FB_VIRTUAL=m
CONFIG_FB_METRONOME=m
CONFIG_FB_BROADSHEET=m
CONFIG_FB_AUO_K190X=m
CONFIG_FB_AUO_K1900=m
CONFIG_FB_AUO_K1901=m
CONFIG_FB_SIMPLE=y
CONFIG_BACKLIGHT_LCD_SUPPORT=y
CONFIG_BACKLIGHT_CLASS_DEVICE=y
CONFIG_FRAMEBUFFER_CONSOLE=y
CONFIG_FRAMEBUFFER_CONSOLE_DETECT_PRIMARY=y
CONFIG_FONTS=y
CONFIG_FONT_8x8=y
CONFIG_FONT_8x16=y
CONFIG_SND_VERBOSE_PRINTK=y
CONFIG_SND_DEBUG=y
CONFIG_SND_DEBUG_VERBOSE=y
CONFIG_SND_PCM_XRUN_DEBUG=y
CONFIG_SND_USB_AUDIO=y
CONFIG_SND_AML_M6_SOC=y
CONFIG_SND_AML_M_DUMMY_CODEC=y
CONFIG_HIDRAW=y
CONFIG_UHID=y
CONFIG_USB_HIDDEV=y
CONFIG_USB=y
CONFIG_USB_ANNOUNCE_NEW_DEVICES=y
CONFIG_USB_STORAGE=y
CONFIG_MMC_DEBUG=y
CONFIG_LEDS_CLASS=y
CONFIG_LEDS_WETEKPLAY=y
CONFIG_LEDS_TRIGGER_TIMER=y
CONFIG_UIO=y
CONFIG_UIO_PDRV=y
# CONFIG_IOMMU_SUPPORT is not set
CONFIG_EXT4_FS=y
CONFIG_FUSE_FS=y
CONFIG_VFAT_FS=y
CONFIG_TMPFS=y
CONFIG_UNION_FS=y
CONFIG_UBIFS_FS=y
CONFIG_NFS_FS=y
CONFIG_NFS_V4=y
CONFIG_NLS_DEFAULT="utf8"
CONFIG_NLS_CODEPAGE_437=y
CONFIG_NLS_ASCII=y
CONFIG_NLS_ISO8859_1=y
CONFIG_NLS_UTF8=y
CONFIG_PRINTK_TIME=y
# CONFIG_SCHED_DEBUG is not set
CONFIG_TIMER_STATS=y
CONFIG_DEBUG_INFO=y
CONFIG_RCU_CPU_STALL_TIMEOUT=60
CONFIG_RCU_TRACE=y
CONFIG_SECURITYFS=y
CONFIG_CRYPTO_AUTHENC=y
CONFIG_CRYPTO_CBC=y
CONFIG_CRYPTO_ECB=y
CONFIG_CRYPTO_XTS=y
CONFIG_CRYPTO_HMAC=y
CONFIG_CRYPTO_MD4=y
CONFIG_CRYPTO_MD5=y
CONFIG_CRYPTO_SHA1=y
CONFIG_CRYPTO_SHA256=y
CONFIG_CRYPTO_SHA512=y
CONFIG_CRYPTO_WP512=y
CONFIG_CRYPTO_DES=y
CONFIG_CRYPTO_TWOFISH=y
CONFIG_CRC_ITU_T=y
CONFIG_LIBCRC32C=y
CONFIG_XZ_DEC=y
CONFIG_XZ_DEC_X86=y
CONFIG_XZ_DEC_POWERPC=y
CONFIG_XZ_DEC_IA64=y
CONFIG_XZ_DEC_SPARC=y
```

## rootfs/Config.in
```kconfig
menu "Firmware configuration"

config BR2_OUTERBOX_SIGNATURE_FILE
	string "Package signagure file"
	help
	  If the resulting .pkg file should be signed
	  specify a path to signature file using this 
	  option.

config BR2_OUTERBOX_TMPFS_SIZE
	string "tmpfs size (in MiB)"
	default 80
	help
	  Because rootfs is read-only, a ramdisk 
	  is created with specified size to allow
	  writing to rootfs at runtime. This option
	  sets the amount of RAM used for the ramdisk.

config BR2_OUTERBOX_VERSIONLESS_PKG
	bool "Omit version in .pkg file"
	default n
	help
	  By omitting the version file in the firmware
	  package, you can prevent version checks and
	  thus create a firmware package that always
	  flashes, regardless of what version is 
	  installed on the target device.

endmenu

menu "Librarian"
	source "$BR2_EXTERNAL/package/python-librarian/Config.in"
if BR2_PACKAGE_PYTHON_LIBRARIAN
comment "Base framework"
	source "$BR2_EXTERNAL/package/python-librarian-core/Config.in"
	source "$BR2_EXTERNAL/package/python-librarian-notifications/Config.in"
	source "$BR2_EXTERNAL/package/python-librarian-content/Config.in"
	source "$BR2_EXTERNAL/package/python-librarian-setup/Config.in"
	source "$BR2_EXTERNAL/package/python-librarian-auth/Config.in"
	source "$BR2_EXTERNAL/package/python-librarian-dashboard/Config.in"
	source "$BR2_EXTERNAL/package/python-librarian-menu/Config.in"
comment "UI skins"
	source "$BR2_EXTERNAL/package/python-librarian-ui/Config.in"
comment "Settings plugins"
	source "$BR2_EXTERNAL/package/python-librarian-logs/Config.in"
	source "$BR2_EXTERNAL/package/python-librarian-ondd/Config.in"
	source "$BR2_EXTERNAL/package/python-librarian-diskspace/Config.in"
	source "$BR2_EXTERNAL/package/python-librarian-netinterfaces/Config.in"
comment "Apps"
	source "$BR2_EXTERNAL/package/python-librarian-filemanager/Config.in"
	source "$BR2_EXTERNAL/package/python-librarian-library/Config.in"
	source "$BR2_EXTERNAL/package/python-librarian-twitter/Config.in"
comment "Content openers"
	source "$BR2_EXTERNAL/package/python-librarian-opener-html/Config.in"
	source "$BR2_EXTERNAL/package/python-librarian-opener-video/Config.in"
comment "Misc"
	source "$BR2_EXTERNAL/package/python-librarian-analytics/Config.in"
	source "$BR2_EXTERNAL/package/python-librarian-captive/Config.in"
endif
comment "Monitoring and reporting"
	source "$BR2_EXTERNAL/package/monitoring/Config.in"
endmenu

menu "Dependencies"
	source "$BR2_EXTERNAL/package/lighttpd-custom/Config.in"
	source "$BR2_EXTERNAL/package/postgresql-95/Config.in"
	source "$BR2_EXTERNAL/package/python-bitarray/Config.in"
	source "$BR2_EXTERNAL/package/python-bottle-fdsend/Config.in"
	source "$BR2_EXTERNAL/package/python-bottle-utils/Config.in"
	source "$BR2_EXTERNAL/package/python-chainable-validators/Config.in"
	source "$BR2_EXTERNAL/package/python-cssmin/Config.in"
	source "$BR2_EXTERNAL/package/python-dateutil/Config.in"
	source "$BR2_EXTERNAL/package/python-fsal/Config.in"
	source "$BR2_EXTERNAL/package/python-gevent/Config.in"
	source "$BR2_EXTERNAL/package/python-greenlet/Config.in"
	source "$BR2_EXTERNAL/package/python-hwd/Config.in"
	source "$BR2_EXTERNAL/package/python-outernet-metadata/Config.in"
	source "$BR2_EXTERNAL/package/python-ondd-ipc/Config.in"
	source "$BR2_EXTERNAL/package/python-pbkdf2/Config.in"
	source "$BR2_EXTERNAL/package/python-pytz/Config.in"
	source "$BR2_EXTERNAL/package/python-scandir/Config.in"
	source "$BR2_EXTERNAL/package/python-sqlize-pg/Config.in"
	source "$BR2_EXTERNAL/package/python-squery-pg/Config.in"
	source "$BR2_EXTERNAL/package/python-webassets/Config.in"
	source "$BR2_EXTERNAL/package/python-psycopg2/Config.in"
	source "$BR2_EXTERNAL/package/python-ua-parser/Config.in"
	source "$BR2_EXTERNAL/package/python-user-agents/Config.in"
	source "$BR2_EXTERNAL/package/python-zippie/Config.in"
endmenu

menu "Firmware management"
	source "$BR2_EXTERNAL/package/pkgtool/Config.in"
	source "$BR2_EXTERNAL/package/pkgtool/Config.in.host"
endmenu

menu "Development"
comment "The packages in this section are only required for building binaries "
comment "for code that is closed-source. Do not enable them for normal builds."
	source "$BR2_EXTERNAL/package/ondd/Config.in"
	source "$BR2_EXTERNAL/package/wptdm/Config.in"
endmenu
```
